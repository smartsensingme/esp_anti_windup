## Kconfig
```kconfig
menu "Shared PID/PR anti-windup"
config ESP_ANTI_WINDUP_IRAM
    bool "Place update and reset in IRAM"
    default y
    help
        Consumes internal instruction RAM to keep coordinator update/reset out
        of flash. Initialization stays in flash. Controllers, models, stack and
        compiler helpers need a separate audit. Does not guarantee deadlines or
        complete cache-off execution. No logging/allocation in the loop.
endmenu
```
